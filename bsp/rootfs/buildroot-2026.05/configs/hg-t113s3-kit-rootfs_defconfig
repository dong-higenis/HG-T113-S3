## bsp/rootfs/buildroot-2026.05/configs/hg-t113s3-kit-rootfs_defconfig
```kconfig
BR2_arm=y
BR2_cortex_a7=y
BR2_TARGET_GENERIC_HOSTNAME="hg-t113s3-kit"
BR2_TARGET_GENERIC_ISSUE="HiGenis HG-T113S3-KIT Linux"
BR2_TARGET_GENERIC_GETTY_PORT="ttyS0"
BR2_TARGET_GENERIC_GETTY_BAUDRATE_115200=y
# BR2_TARGET_GENERIC_REMOUNT_ROOTFS_RW is not set
BR2_ROOTFS_OVERLAY="~/git_project/bsp/rootfs/rootfs-overlay"
BR2_PACKAGE_DOSFSTOOLS=y
BR2_PACKAGE_DOSFSTOOLS_FSCK_FAT=y
BR2_PACKAGE_DOSFSTOOLS_MKFS_FAT=y
BR2_PACKAGE_E2FSPROGS=y
BR2_PACKAGE_EXFAT=y
BR2_PACKAGE_EXFAT_UTILS=y
BR2_TARGET_ROOTFS_SQUASHFS=y
BR2_TARGET_ROOTFS_SQUASHFS4_XZ=y
```
